## c6_slave/sdkconfig.defaults.esp32c6
```kconfig
# 1. CPU
#--------
CONFIG_ESP_DEFAULT_CPU_FREQ_MHZ_160=y

# 2. BT Configuration
#---------------------
CONFIG_BT_ENABLED=n
CONFIG_BT_CONTROLLER_ONLY=n
CONFIG_ESP_HOSTED_CP_BT=n

# 3.1 BLE over SPI/SDIO
#-----------------------
CONFIG_BT_LE_HCI_INTERFACE_USE_RAM=y

# 3.2 BLE over UART
#-------------------
# Enable below config, delete sdkconfig, build/ and rebuild
# CONFIG_BT_LE_HCI_INTERFACE_USE_UART=y
# CONFIG_BT_LE_HCI_UART_TX_PIN=5
# CONFIG_BT_LE_HCI_UART_RX_PIN=12
# CONFIG_BT_LE_HCI_UART_FLOWCTRL=n
# # 4 pin solution is not working yet for c6
# #CONFIG_BT_LE_HCI_UART_RTS_PIN=9
# #CONFIG_BT_LE_HCI_UART_CTS_PIN=13


# 4. Partition Table
#--------------------
CONFIG_PARTITION_TABLE_CUSTOM=y
CONFIG_PARTITION_TABLE_CUSTOM_FILENAME="partitions.esp32c6.csv"

# 5. Mempool
#------------
CONFIG_ESP_CACHE_MALLOC=n


# 6 Network split
#-----------------
CONFIG_ESP_HOSTED_NETWORK_SPLIT_ENABLED=y
CONFIG_ESP_HOSTED_NETWORK_SPLIT_WIFI_AUTO_MGMT=y
CONFIG_ESP_DEFAULT_LWIP_SLAVE=y
CONFIG_ESP_HOSTED_HOST_RESERVED_PORTS_CONFIGURED=y
CONFIG_ESP_HOSTED_HOST_RESERVED_TCP_DEST_PORTS="22,80,443,8554"
CONFIG_LWIP_TCP_LOCAL_PORT_RANGE_START=61440
CONFIG_LWIP_TCP_LOCAL_PORT_RANGE_END=65535
CONFIG_LWIP_UDP_LOCAL_PORT_RANGE_START=61440
CONFIG_LWIP_UDP_LOCAL_PORT_RANGE_END=65535
CONFIG_LWIP_TCP_REMOTE_PORT_RANGE_START=49152
CONFIG_LWIP_TCP_REMOTE_PORT_RANGE_END=61439
CONFIG_LWIP_UDP_REMOTE_PORT_RANGE_START=49152
CONFIG_LWIP_UDP_REMOTE_PORT_RANGE_END=61439


# 7. Transport config
#---------------------
CONFIG_ESP_HOST_DEV_BOARD_P4_FUNC_BOARD=y
CONFIG_ESP_SDIO_HOST_INTERFACE=y
# CONFIG_ESP_SDIO_NSEND_PSAMPLE=y
# CONFIG_ESP_SDIO_DEFAULT_SPEED=y
# CONFIG_ESP_SDIO_STREAMING_MODE=n

# For SPI Full duplex C6 on ESP32-P4-Function-EV-Board, please uncomment below
#CONFIG_ESP_HOST_DEV_BOARD_P4_FUNC_BOARD=y
#CONFIG_ESP_SPI_HOST_INTERFACE=y


# 8. Wifi config
#----------------
CONFIG_ESP_HOSTED_USE_EXAMPLE_WIFI_PRE_PROVISION_CONFIG=y
CONFIG_ESP_WIFI_SSID="YOUR_WIFI_SSID"
CONFIG_ESP_WIFI_PASSWORD="YOUR_WIFI_PASSWORD"
CONFIG_WIFI_CMD_BASIC_ONLY=y

CONFIG_ESP_WIFI_STATIC_RX_BUFFER_NUM=10
CONFIG_ESP_WIFI_DYNAMIC_RX_BUFFER_NUM=32
CONFIG_ESP_WIFI_DYNAMIC_TX_BUFFER_NUM=32
CONFIG_ESP_WIFI_AMPDU_TX_ENABLED=y
CONFIG_ESP_WIFI_TX_BA_WIN=32
CONFIG_ESP_WIFI_AMPDU_RX_ENABLED=y
CONFIG_ESP_WIFI_RX_BA_WIN=6

CONFIG_ESP_WIFI_RX_IRAM_OPT=y
CONFIG_ESP_WIFI_IRAM_OPT=y

# 9. LWIP config
#----------------
CONFIG_LWIP_TCP_SND_BUF_DEFAULT=11520
CONFIG_LWIP_TCP_WND_DEFAULT=11520
CONFIG_LWIP_TCP_RECVMBOX_SIZE=16
CONFIG_LWIP_UDP_RECVMBOX_SIZE=16
CONFIG_LWIP_TCPIP_RECVMBOX_SIZE=32
CONFIG_LWIP_TCP_SACK_OUT=y
CONFIG_LWIP_TCPIP_CORE_LOCKING=y
CONFIG_LWIP_TCPIP_CORE_LOCKING_INPUT=y


# 10. Optimizations
#-------------------
CONFIG_COMPILER_OPTIMIZATION_PERF=y


# 11. Stats
#-----------
#CONFIG_ESP_HOSTED_FUNCTION_PROFILING=y
#CONFIG_ESP_PKT_STATS=y
```

## firmware/c6_hosted/sdkconfig.defaults
```kconfig
# BT Configuration
CONFIG_BT_ENABLED=n
CONFIG_BT_CONTROLLER_ONLY=n
CONFIG_ESP_HOSTED_CP_BT=n

# P4-to-C6 frame receiver application.
CONFIG_ESP_HOSTED_EXTRA_EXAMPLES=y
CONFIG_EXAMPLE_PEER_DATA_TRANSFER=y
CONFIG_ESP_HOSTED_ENABLE_PEER_DATA_TRANSFER=y
CONFIG_ESP_HOSTED_MAX_CUSTOM_MSG_HANDLERS=3
CONFIG_C6_FRAME_HTTP_PORT=8081
CONFIG_C6_FRAME_MAX_JPEG_SIZE=196608

# OTA
CONFIG_ESPTOOLPY_FLASHSIZE_4MB=y
CONFIG_PARTITION_TABLE_TWO_OTA=y

# OS
CONFIG_FREERTOS_HZ=1000
CONFIG_ESP_WIFI_NVS_ENABLED=y
CONFIG_BOOTLOADER_COMPILER_OPTIMIZATION_PERF=y

#Disable enterprise support by default
CONFIG_ESP_WIFI_ENTERPRISE_SUPPORT=n

##
## Power Management
##
#CONFIG_PM_ENABLE=y
#CONFIG_FREERTOS_USE_TICKLESS_IDLE=y
##
## BLE + Light Sleep: MANDATORY - Enable MAC BB power down
#CONFIG_ESP_PHY_MAC_BB_PD=y
## Without this: Light sleep will be disabled if BT is enabled
##
## Down digital peripherals in light sleep
#CONFIG_PM_POWER_DOWN_PERIPHERAL_IN_LIGHT_SLEEP=y
##
#
## host power save - wake up
#CONFIG_ESP_HOSTED_HOST_POWER_SAVE_ENABLED=y
#CONFIG_ESP_HOSTED_UNLOAD_BUS_DRIVER_DURING_HOST_SLEEP=y
#CONFIG_ESP_HOSTED_LIGHT_SLEEP_ENABLE=y
#CONFIG_ESP_HOSTED_LIGHT_SLEEP_PERIPHERAL_POWERDOWN=y
#CONFIG_ESP_HOSTED_LIGHT_SLEEP_MIN_FREQ_MHZ=10

## Examples
#CONFIG_ESP_HOSTED_EXTRA_EXAMPLES=y
#CONFIG_ESP_HOSTED_COPROCESSOR_EXAMPLE_LIGHT_SLEEP=y
#
#CONFIG_ESP_HOST_DEV_BOARD_P4_C5_CORE=y
```

## firmware/server/main/Kconfig.projbuild
```kconfig
menu "Mesh image server"

    config SERVER_MAX_NODES
        int "Maximum provisioned C6 nodes"
        range 1 100
        default 10
        help
            Runtime bookkeeping capacity for newly provisioned C6 sources.
            ESP-BLE-Mesh has its own matching provisioning-node limit.

    config SERVER_FRAME_TIMEOUT_MS
        int "Inactive frame timeout (milliseconds)"
        range 5000 120000
        default 30000
        help
            Abort a frame when no valid OPEN, DATA, or END for this duration.

    config SERVER_TEST_DROP_CHUNK_INDEX
        int "One-shot DATA drop index for NACK testing"
        range -1 82
        default -1
        help
            -1 disables fault injection. Any other value drops that DATA
            chunk once after boot while an active matching frame exists, so
            the following END must produce a bitmap NACK.

    config SERVER_SERIAL_IMAGE_ENABLE
        bool "Framed JPEG records on the console stream"
        default y
        help
            Copy each completed Mesh JPEG into a fixed-capacity queue backed
            by one internal-RAM slot preallocated during startup, and
            transmit it atomically on the same stdout stream as text event
            logs. Use the supplied PC receiver instead of idf.py monitor.
            This image exporter is mutually exclusive with the HTTP exporter,
            but it can run together with SERVER_WIFI_SNTP_ENABLE. A 921600-baud
            console is recommended.

    config SERVER_WIFI_SNTP_ENABLE
        bool "Wi-Fi STA and persistent SNTP server clock"
        depends on SOC_WIFI_SUPPORTED
        default n
        help
            Connect a Wi-Fi-capable server to an access point and maintain its
            Unix wall clock with SNTP. This is independent of the serial and
            HTTP image exporters, so an ESP32-CAM can keep exporting JPEGs on
            UART while it supplies time to C6 nodes. ESP32-H2 excludes this
            source entirely.

    if SERVER_WIFI_SNTP_ENABLE

        config SERVER_WIFI_SSID
            string "Wi-Fi SSID"
            default ""

        config SERVER_WIFI_PASSWORD
            string "Wi-Fi password"
            default ""

        config SERVER_SNTP_SERVER
            string "SNTP server"
            default "pool.ntp.org"

        config SERVER_SNTP_MAX_AGE_MS
            int "Maximum accepted SNTP clock age (milliseconds)"
            range 60000 86400000
            default 7200000
            help
                Stop advertising the wall clock as valid when this much
                monotonic time has elapsed since the last successful SNTP
                update. The two-hour default allows one missed hourly poll
                without distributing a clock that has been offline forever.

    endif

    config SERVER_HTTP_ENABLE
        bool "Latest-image HTTP adapter"
        depends on SOC_WIFI_SUPPORTED && !SERVER_SERIAL_IMAGE_ENABLE
        select SERVER_WIFI_SNTP_ENABLE
        default n
        help
            Optional latest-image exporter for Wi-Fi-capable targets. Wi-Fi
            STA and SNTP are owned by SERVER_WIFI_SNTP_ENABLE, avoiding a
            second network stack initialization. ESP32-H2 excludes this
            source entirely.

    if SERVER_HTTP_ENABLE

        config SERVER_HTTP_PORT
            int "HTTP port"
            range 1 65535
            default 80

    endif

endmenu
```

## firmware/server/sdkconfig.defaults.esp32h2
```kconfig
CONFIG_BT_LE_SCAN_DUPL_TYPE_DATA_DEVICE=y
CONFIG_BT_BLE_42_FEATURES_SUPPORTED=y
CONFIG_BT_BLE_50_FEATURES_SUPPORTED=n
CONFIG_BT_LE_50_FEATURE_SUPPORT=n
CONFIG_ESP_CONSOLE_SECONDARY_NONE=y
```

## firmware/server/sdkconfig.defaults.esp32s3
```kconfig
CONFIG_BT_CTRL_SCAN_DUPL_TYPE_DATA_DEVICE=y
CONFIG_BT_CTRL_BLE_MESH_SCAN_DUPL_EN=y
CONFIG_BT_BLE_42_FEATURES_SUPPORTED=y
CONFIG_BT_BLE_50_FEATURES_SUPPORTED=n
CONFIG_ESP_CONSOLE_SECONDARY_NONE=y
```

## main/Kconfig.projbuild
```kconfig
menu "Example Configuration"

    config EXAMPLE_ENABLE_MIPI_CSI_CAM_SENSOR
        bool "Enable MIPI CSI Camera Sensor"
        default y
        depends on ESP_VIDEO_ENABLE_MIPI_CSI_VIDEO_DEVICE

    if EXAMPLE_ENABLE_MIPI_CSI_CAM_SENSOR
        config EXAMPLE_MIPI_CSI_SCCB_I2C_PORT
            int "MIPI CSI SCCB I2C Port Number"
            default 0
            range 0 1

        config EXAMPLE_MIPI_CSI_SCCB_I2C_SCL_PIN
            int "MIPI CSI SCCB I2C SCL Pin"
            default 8
            range -1 56

        config EXAMPLE_MIPI_CSI_SCCB_I2C_SDA_PIN
            int "MIPI CSI SCCB I2C SDA Pin"
            default 7
            range -1 56

        config EXAMPLE_MIPI_CSI_SCCB_I2C_FREQ
            int "MIPI CSI SCCB I2C Frequency"
            default 100000
            range 100000 400000
            help
                Increasing this value can reduce the initialization time of the camera sensor.
                Please refer to the relevant instructions of the camera sensor to adjust the value.

        config EXAMPLE_MIPI_CSI_CAM_SENSOR_RESET_PIN
            int "MIPI CSI Camera Sensor Reset Pin"
            default -1
            range -1 56

        config EXAMPLE_MIPI_CSI_CAM_SENSOR_PWDN_PIN
            int "MIPI CSI Camera Sensor Power Down Pin"
            default -1
            range -1 56
    endif

    config EXAMPLE_ENABLE_DVP_CAM_SENSOR
        bool "Enable DVP Camera Sensor"
        default n
        depends on ESP_VIDEO_ENABLE_DVP_VIDEO_DEVICE

    if EXAMPLE_ENABLE_DVP_CAM_SENSOR
        config EXAMPLE_DVP_SCCB_I2C_PORT
            int "DVP SCCB I2C Port Number"
            default 1
            range 0 1

        config EXAMPLE_DVP_SCCB_I2C_SCL_PIN
            int "DVP SCCB I2C SCL Pin"
            default 33
            range -1 56

        config EXAMPLE_DVP_SCCB_I2C_SDA_PIN
            int "DVP SCCB I2C SDA Pin"
            default 32
            range -1 56

        config EXAMPLE_DVP_SCCB_I2C_FREQ
            int "DVP SCCB I2C Frequency"
            default 100000
            range 100000 400000
            help
                Increasing this value can reduce the initialization time of the camera sensor.
                Please refer to the relevant instructions of the camera sensor to adjust the value.

        config EXAMPLE_DVP_CAM_SENSOR_RESET_PIN
            int "DVP Camera Sensor Reset Pin"
            default -1
            range -1 56

        config EXAMPLE_DVP_CAM_SENSOR_PWDN_PIN
            int "DVP Camera Sensor Power Down Pin"
            default -1
            range -1 56

        config EXAMPLE_DVP_XCLK_FREQ
            int "DVP XCLK Frequency"
            default 20000000

        config EXAMPLE_DVP_XCLK_PIN
            int "DVP XCLK Pin"
            range 0 56
            default 20

        config EXAMPLE_DVP_PCLK_PIN
            int "DVP PCLK Pin"
            range 0 56
            default 21

        config EXAMPLE_DVP_VSYNC_PIN
            int "DVP VSYNC Pin"
            range 0 56
            default 23

        config EXAMPLE_DVP_DE_PIN
            int "DVP DE Pin"
            range 0 56
            default 22

        config EXAMPLE_DVP_D0_PIN
            int "DVP D0 Pin"
            range 0 56
            default 53

        config EXAMPLE_DVP_D1_PIN
            int "DVP D1 Pin"
            range 0 56
            default 54

        config EXAMPLE_DVP_D2_PIN
            int "DVP D2 Pin"
            range 0 56
            default 52

        config EXAMPLE_DVP_D3_PIN
            int "DVP D3 Pin"
            range 0 56
            default 1

        config EXAMPLE_DVP_D4_PIN
            int "DVP D4 Pin"
            range 0 56
            default 0

        config EXAMPLE_DVP_D5_PIN
            int "DVP D5 Pin"
            range 0 56
            default 45

        config EXAMPLE_DVP_D6_PIN
            int "DVP D6 Pin"
            range 0 56
            default 46

        config EXAMPLE_DVP_D7_PIN
            int "DVP D7 Pin"
            range 0 56
            default 47
    endif

    menu "Capture SD Card Configuration"

        config EXAMPLE_CAPTURE_SDMMC_SLOT
            int "SDMMC slot"
            default 0
            range 0 1
            help
                SDMMC host slot used by the microSD card.
                On ESP32-P4 Function EV Board, ESP-Hosted Wi-Fi uses slot 1,
                so the onboard microSD card should use slot 0.

        choice EXAMPLE_CAPTURE_SDMMC_BUS_WIDTH
            prompt "SD/MMC bus width"
            default EXAMPLE_CAPTURE_SDMMC_BUS_WIDTH_1
            help
                Use 1-line mode for maximum compatibility. 4-line mode is
                faster, but it requires D1-D3 to be wired and pulled up correctly.

            config EXAMPLE_CAPTURE_SDMMC_BUS_WIDTH_1
                bool "1-line mode"

            config EXAMPLE_CAPTURE_SDMMC_BUS_WIDTH_4
                bool "4-line mode"
        endchoice

        config EXAMPLE_CAPTURE_SDMMC_CLK_PIN
            int "CLK pin GPIO number"
            default 43 if IDF_TARGET_ESP32P4
            default 1
            range 0 56

        config EXAMPLE_CAPTURE_SDMMC_CMD_PIN
            int "CMD pin GPIO number"
            default 44 if IDF_TARGET_ESP32P4
            default 1
            range 0 56

        config EXAMPLE_CAPTURE_SDMMC_D0_PIN
            int "D0 pin GPIO number"
            default 39 if IDF_TARGET_ESP32P4
            default 1
            range 0 56

        config EXAMPLE_CAPTURE_SD_PWR_CTRL_LDO_INTERNAL_IO
            depends on SOC_SDMMC_IO_POWER_EXTERNAL
            bool "SD power supply comes from internal LDO IO"
            default y if IDF_TARGET_ESP32P4
            help
                Enable this when the SD card VDD is supplied by an ESP32-P4
                internal LDO output. The ESP32-P4 Function EV Board microSD
                slot uses this path.

        config EXAMPLE_CAPTURE_SD_PWR_CTRL_LDO_IO_ID
            depends on SOC_SDMMC_IO_POWER_EXTERNAL && EXAMPLE_CAPTURE_SD_PWR_CTRL_LDO_INTERNAL_IO
            int "SD power LDO ID"
            default 4 if IDF_TARGET_ESP32P4
            range 0 4
            help
                Internal LDO channel used to power the SD card IO rail.

        config EXAMPLE_CAPTURE_SD_CARD_POWER_RESET
            depends on SOC_SDMMC_IO_POWER_EXTERNAL
            bool "Reset SD card power before mount"
            default y if IDF_TARGET_ESP32P4
            help
                Toggle the SD card power reset GPIO before probing the card.
                This helps recover cards left in a bad state after a failed
                initialization.

        config EXAMPLE_CAPTURE_SD_CARD_POWER_RESET_PIN
            depends on SOC_SDMMC_IO_POWER_EXTERNAL && EXAMPLE_CAPTURE_SD_CARD_POWER_RESET
            int "SD card power reset GPIO"
            default 45 if IDF_TARGET_ESP32P4
            range 0 56

        if EXAMPLE_CAPTURE_SDMMC_BUS_WIDTH_4

            config EXAMPLE_CAPTURE_SDMMC_D1_PIN
                int "D1 pin GPIO number"
                default 40 if IDF_TARGET_ESP32P4
                default 1
                range 0 56

            config EXAMPLE_CAPTURE_SDMMC_D2_PIN
                int "D2 pin GPIO number"
                default 41 if IDF_TARGET_ESP32P4
                default 1
                range 0 56

            config EXAMPLE_CAPTURE_SDMMC_D3_PIN
                int "D3 pin GPIO number"
                default 42 if IDF_TARGET_ESP32P4
                default 1
                range 0 56

        endif

    endmenu
    
endmenu
```
