## sdkconfig.defaults
```kconfig
CONFIG_SPIRAM=y
CONFIG_IDF_EXPERIMENTAL_FEATURES=y
CONFIG_SPIRAM_SPEED_200M=y

CONFIG_LWIP_TCPIP_RECVMBOX_SIZE=64
CONFIG_LWIP_TCP_SND_BUF_DEFAULT=65535
CONFIG_LWIP_TCP_WND_DEFAULT=65535
CONFIG_LWIP_TCP_RECVMBOX_SIZE=64

# Use a larger app partition for esp-dl classifier assets in flash rodata.
# CONFIG_PARTITION_TABLE_SINGLE_APP is not set
CONFIG_PARTITION_TABLE_CUSTOM=y
CONFIG_PARTITION_TABLE_CUSTOM_FILENAME="partitions.csv"

CONFIG_CAMERA_OV5647=y
# CONFIG_CAMERA_SC2336 is not set
CONFIG_CAMERA_OV5647_AUTO_DETECT_MIPI_INTERFACE_SENSOR=y
# CONFIG_CAMERA_OV5647_MIPI_RAW8_800X640_50FPS is not set
CONFIG_CAMERA_OV5647_MIPI_RAW8_800X800_50FPS=y
# CONFIG_CAMERA_OV5647_MIPI_RAW8_800X1280_50FPS is not set
# CONFIG_CAMERA_OV5647_MIPI_RAW10_1920X1080_30FPS is not set
# CONFIG_CAMERA_OV5647_MIPI_RAW10_1280X960_BINNING_45FPS is not set
CONFIG_CAMERA_OV5647_MIPI_DEFAULT_FMT_RAW8_800X800_50FPS=y
CONFIG_CAMERA_OV5647_MIPI_IF_FORMAT_INDEX_DEFAULT=2
CONFIG_CAMERA_OV5647_CSI_LINESYNC_ENABLE=y
CONFIG_CAMERA_OV5647_DEFAULT_IPA_JSON_CONFIGURATION_FILE=y
```
